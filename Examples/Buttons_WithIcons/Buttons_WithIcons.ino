#include <ILI9341_t3.h>  // fast display driver lib
#include <ILI9341_t3_Controls.h>
#include <XPT2046_Touchscreen.h>
#include <Colors.h>
#define CS_PIN    10
#define DC_PIN    9
#define T_CS    0
#define T_IRQ   1

unsigned long i;
int BtnX, BtnY;

ILI9341_t3 Display(CS_PIN, DC_PIN); //Display object

XPT2046_Touchscreen Touch = XPT2046_Touchscreen(0, 1);

TS_Point TouchPoint;

Button ButtonIcon(&Display);

// 'Settings_Pressed', 50x50px
const uint16_t Settings_Pressed [] PROGMEM = {
	0x0000, 0x0000, 0x0000, 0x0000, 0x0000, 0x0000, 0x0000, 0x0000, 0x0020, 0x0000, 0x0000, 0x0000, 0x0000, 0x0000, 0x0000, 0x0000, 
	0x0000, 0x0000, 0x0000, 0x0020, 0x0020, 0x0800, 0x1020, 0x1020, 0x1020, 0x1020, 0x1020, 0x1020, 0x0820, 0x0000, 0x0020, 0x0020, 
	0x0000, 0x0000, 0x0000, 0x0000, 0x0000, 0x0000, 0x0000, 0x0000, 0x0000, 0x0000, 0x0020, 0x0020, 0x0000, 0x0000, 0x0000, 0x0000, 
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	0x0000, 0x0000, 0x0000, 0x0000
};



// 'Settings', 50x50px
const uint16_t Settings [] PROGMEM = {
	0x0000, 0x0000, 0x0000, 0x0000, 0x0000, 0x0000, 0x0000, 0x0020, 0x0020, 0x0000, 0x0000, 0x0000, 0x0000, 0x0000, 0x0000, 0x0000, 
	0x0000, 0x0000, 0x0020, 0x0841, 0x0020, 0x0800, 0x1800, 0x2000, 0x2000, 0x2000, 0x2000, 0x2000, 0x1800, 0x0800, 0x0020, 0x0841, 
	0x0000, 0x0000, 0x0000, 0x0000, 0x0000, 0x0000, 0x0000, 0x0000, 0x0000, 0x0000, 0x0841, 0x0841, 0x0000, 0x0000, 0x0000, 0x0000, 
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	0x0000, 0x0000, 0x0000, 0x0000
};



void setup() {

  Serial.begin(57600);

  // fire up the display
  Display.begin();
  Display.setRotation(1);
  Display.fillScreen(C_BLACK);
  analogWrite(A9, 255);
  // fire up the touch display

  // you may need this depending on your display
  Touch.begin();

  Touch.setRotation(3);
  ButtonIcon.init(180, 140, 56, 56, C_BLACK, C_BLACK, C_BLACK, C_BLACK, Settings, Settings_Pressed, 50, 50, 3, 3);
  ButtonIcon.setCornerRadius(2);

  ButtonIcon.draw();



}


void loop() {

delay(10);
  if (Touch.touched()) {

    ProcessTouch();

    if (ProcessButtonPress(ButtonIcon)) {
Serial.println("pressed");
    }
  }
}


void ProcessTouch() {

  TouchPoint = Touch.getPoint();

  BtnX = TouchPoint.x;
  BtnY = TouchPoint.y;

  // consistency between displays is a mess...
  // this is some debug code to help show
  // where you pressed and the resulting map

  //Serial.print("real coordinates: ");
  //Serial.print(BtnX);
  //Serial.print(",");
  //Serial.println (BtnY);
  //Display.drawPixel(BtnX, BtnY, C_RED);

  //different values depending on where touch happened

  // x  = map(x, real left, real right, 0, 480);
  // y  = map(y, real bottom, real top, 320, 0);

  // tft with yellow headers
  //BtnX  = map(BtnX, 240, 0, 320, 0);
  //BtnY  = map(BtnY, 379, 0, 240, 0);

  // tft with black headers
  BtnX = map(BtnX, 300, 3500, 0, 320);
  BtnY = map(BtnY, 230, 3700, 0, 240);

  //Serial.print(", Mapped coordinates: ");
  //Serial.print(BtnX);
  //Serial.print(",");
  //Serial.println(BtnY);
  //Display.drawPixel(BtnX, BtnY, C_GREEN);
}

// my custom function to process a button press
// if user presses a button show button in different color
// if user continues to press a button, wait until release
// to do something, I didn't find a good way to implement Adafruits
// methods, so i created my own
bool ProcessButtonPress(Button TheButton) {

  if (TheButton.press(BtnX, BtnY)) {
    TheButton.draw(B_PRESSED);
    while (Touch.touched()) {
      if (TheButton.press(BtnX, BtnY)) {
        
        TheButton.draw(B_PRESSED);
      } else {
        TheButton.draw(B_RELEASED);
        return false;
      }
      ProcessTouch();
    }

    TheButton.draw(B_RELEASED);
    return true;
  }
  return false;
}